## main/Kconfig.projbuild
```kconfig
menu "NRF24 dual"
    config NRF1_CE_GPIO
        int "Radio 1 (SPI2): CE"
        default 9
    config NRF1_CS_GPIO
        int "Radio 1 (SPI2): CSN"
        default 10
    config NRF1_SCK_GPIO
        int "Radio 1 (SPI2): SCK"
        default 12
    config NRF1_MOSI_GPIO
        int "Radio 1 (SPI2): MOSI"
        default 11
    config NRF1_MISO_GPIO
        int "Radio 1 (SPI2): MISO"
        default 13
    config NRF1_IRQ_GPIO
        int "Radio 1 (SPI2): IRQ (-1 = sin usar)"
        default 14
    config NRF2_CE_GPIO
        int "Radio 2 (SPI3): CE"
        default 4
    config NRF2_CS_GPIO
        int "Radio 2 (SPI3): CSN"
        default 5
    config NRF2_SCK_GPIO
        int "Radio 2 (SPI3): SCK"
        default 7
    config NRF2_MOSI_GPIO
        int "Radio 2 (SPI3): MOSI"
        default 6
    config NRF2_MISO_GPIO
        int "Radio 2 (SPI3): MISO"
        default 8
    config NRF2_IRQ_GPIO
        int "Radio 2 (SPI3): IRQ (-1 = sin usar)"
        default 15
    config JAM_CORE
        int "Core para la tarea de jamming (-1 = sin pinning)"
        default -1
    config WS_GPIO
        int "GPIO del LED WS2812"
        default 48
        help
            GPIO48 = LED RGB de la placa ESP32-S3-DevKitC-1.
            Si es externo, pone tu pin.
    config WS_COUNT
        int "Cantidad de LEDs WS2812"
        default 1
        range 1 64
endmenu
```
